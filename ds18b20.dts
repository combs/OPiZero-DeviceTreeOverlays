/dts-v1/;
/plugin/;

/ {
	compatible = "allwinner,sun8i-h2-plus";

	fragment@0 {
		target = <&pio>;
		__overlay__ {
			dallas_w1_pins: dallas_w1_pins {
				pins = "PA01";
				function = "gpio_in";
				bias-pull-up;
			};
		};
	};

	fragment@1 {
		target-path = "/";
		__overlay__ {
            onewire {
                compatible      = "w1-gpio";
                pinctrl-names   = "default";
                pinctrl-0       = <&dallas_w1_pins>;
                status          = "okay";
                gpios           = <&pio 0 1 0>;
            };
		};
	};
};